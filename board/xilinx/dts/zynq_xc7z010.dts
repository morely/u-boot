/*
 * Xilinx 7z010 board DTS
 *
 * Copyright (C) 2013 Xilinx, Inc.
 *
 * SPDX-License-Identifier:	GPL-2.0+
 */
/dts-v1/;
#include "zynq-7000.dtsi"

/ {
	model = "Zynq XC7Z010 Board";
	compatible = "xlnx,zynq-xc7z010", "xlnx,zynq-7000";
};
